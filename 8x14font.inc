
;------------------------------------------------------------------------------
;
;	Tabelle für Schriftzeichen 8x14pxl
;
;	Filename:		8x14font.inc
;	Date:			01/2010
;	Version:		1.0
;	Target:			hD2 / ATxmega 128A1
;	Author:			mj, ACMC
;	Support-Email:	acmc@hs-mittweida.de
;	
;------------------------------------------------------------------------------


.cseg

Font8x14:
	.db  0x00 , 0x00 , 0x00 , 0x00 , 0x00 , 0x00 , 0x00 , 0x00 , 0x00 , 0x00 , 0x00 , 0x00 , 0x00 , 0x00      // space (32)
	.db  0x00 , 0x00 , 0x00 , 0x18 , 0x3C , 0x3C , 0x3C , 0x18 , 0x18 , 0x00 , 0x18 , 0x18 , 0x00 , 0x00      // !
	.db  0x00 , 0x66 , 0x66 , 0x66 , 0x24 , 0x00 , 0x00 , 0x00 , 0x00 , 0x00 , 0x00 , 0x00 , 0x00 , 0x00      // Anführungszeichen
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    .db  0x00 , 0x00 , 0x00 , 0x18 , 0x24 , 0x24 , 0x18 , 0x00 , 0x00 , 0x00 , 0x00 , 0x00 , 0x00 , 0x00 	  // °

;------------------------------------------------------------------------------


